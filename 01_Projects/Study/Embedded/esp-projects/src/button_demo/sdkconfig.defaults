## 01_Projects/Study/Embedded/esp-projects/src/button_demo/sdkconfig.defaults
```kconfig
# ===== 按键练习工程配置 =====
# 目标芯片:ESP32-S3
CONFIG_IDF_TARGET="esp32s3"
# 板载 Flash 为 16MB
CONFIG_ESPTOOLPY_FLASHSIZE_16MB=y
# 控制台输出到 USB 串口(COM3),方便直接看日志
CONFIG_ESP_CONSOLE_USB_SERIAL_JTAG=y
```

## 01_Projects/Study/Embedded/esp-projects/src/clock/sdkconfig.defaults
```kconfig
# ===== 时钟工程配置 =====
# 目标芯片:ESP32-S3
CONFIG_IDF_TARGET="esp32s3"
# 板载 Flash 为 16MB
CONFIG_ESPTOOLPY_FLASHSIZE_16MB=y
# 使用官方例程的 16MiB 分区表
CONFIG_PARTITION_TABLE_CUSTOM=y
CONFIG_PARTITION_TABLE_CUSTOM_FILENAME="partitions-16MiB.csv"
# 控制台输出到 USB 串口(COM3),方便直接看日志
CONFIG_ESP_CONSOLE_USB_SERIAL_JTAG=y
```
